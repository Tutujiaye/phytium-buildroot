## configs/phytium_e2000_defconfig
```kconfig
# Architecture
BR2_aarch64=y

# Toolchain
BR2_TOOLCHAIN_EXTERNAL=y

# Hostname and issue
BR2_TARGET_GENERIC_HOSTNAME="E2000"
BR2_TARGET_GENERIC_ISSUE="Welcome to Phytium Buildroot"

# system configuration
BR2_ROOTFS_DEVICE_CREATION_DYNAMIC_EUDEV=y
BR2_SYSTEM_BIN_SH_BASH=y
BR2_TARGET_GENERIC_GETTY_PORT="ttyAMA1"
BR2_TARGET_GENERIC_GETTY_BAUDRATE_115200=y
BR2_ROOTFS_OVERLAY="board/phytium/common/busybox_init_overlay"

# Filesystem
BR2_TARGET_ROOTFS_EXT2=y
BR2_TARGET_ROOTFS_EXT2_4=y
BR2_TARGET_ROOTFS_EXT2_SIZE="200M"

# Bootloader
BR2_TARGET_GRUB2=y

# required tools to create the microSD image
BR2_PACKAGE_HOST_DOSFSTOOLS=y
BR2_PACKAGE_HOST_GENIMAGE=y
BR2_PACKAGE_HOST_MTOOLS=y

# Kernel
BR2_LINUX_KERNEL=y
BR2_LINUX_KERNEL_CUSTOM_GIT=y
BR2_LINUX_KERNEL_CUSTOM_REPO_URL="https://gitee.com/phytium_embedded/phytium-linux-kernel.git"
# kernel 5.10
BR2_LINUX_KERNEL_CUSTOM_REPO_VERSION="kernel_5.10_2023-v1.0-RC1"
BR2_LINUX_KERNEL_DEFCONFIG="phytium"
BR2_LINUX_KERNEL_IMAGE_TARGET_CUSTOM=y
BR2_LINUX_KERNEL_IMAGE_TARGET_NAME="Image"
BR2_LINUX_KERNEL_DTS_SUPPORT=y
BR2_LINUX_KERNEL_INTREE_DTS_NAME="phytium/e2000d-demo-board phytium/e2000d-miniitx-board phytium/e2000d-power-board phytium/e2000q-come-board  phytium/e2000q-demo-board phytium/e2000q-edu-board  phytium/e2000q-hanwei-board phytium/e2000q-miniitx-board phytium/e2000q-vpx-board phytium/e2000s-demo-board"
BR2_LINUX_KERNEL_NEEDS_HOST_OPENSSL=y

# Target packages
BR2_PACKAGE_BUSYBOX_SHOW_OTHERS=y
BR2_PACKAGE_GZIP=y
BR2_PACKAGE_GDB=y
BR2_PACKAGE_NETPERF=y
BR2_PACKAGE_RT_TESTS=y
BR2_PACKAGE_STRACE=y
BR2_PACKAGE_GREP=y
BR2_PACKAGE_CIFS_UTILS=y
BR2_PACKAGE_E2FSPROGS=y
BR2_PACKAGE_E2FSPROGS_RESIZE2FS=y
BR2_PACKAGE_MTD=y
BR2_PACKAGE_I2C_TOOLS=y
BR2_PACKAGE_PCIUTILS=y
BR2_PACKAGE_SYSSTAT=y
BR2_PACKAGE_FLICKCURL=y
BR2_PACKAGE_FLICKCURL_UTILS=y
BR2_PACKAGE_LIBCURL_CURL=y
BR2_PACKAGE_LIBCURL_VERBOSE=y
BR2_PACKAGE_COLLECTD=y
BR2_PACKAGE_COLLECTD_CURL=y
BR2_PACKAGE_COLLECTD_CURL_JSON=y
BR2_PACKAGE_COLLECTD_CURL_XML=y
BR2_PACKAGE_DHCPCD=y
BR2_PACKAGE_ETHTOOL=y
BR2_PACKAGE_IPERF=y
BR2_PACKAGE_IPERF3=y
BR2_PACKAGE_IPROUTE2=y
BR2_PACKAGE_OPENSSH=y
BR2_PACKAGE_TCPDUMP=y
BR2_PACKAGE_WGET=y
BR2_PACKAGE_WIRELESS_REGDB=y
BR2_PACKAGE_PROCPS_NG=y
BR2_PACKAGE_NANO=y
BR2_PACKAGE_VIM=y
```

## package/phytium-optee/Config.in
```kconfig
config BR2_PACKAGE_PHYTIUM_OPTEE
	bool "phytium_optee"
	help
	  Phytium OPTEE provides OP-TEE OS, client, examples.


if BR2_PACKAGE_PHYTIUM_OPTEE

config BR2_PACKAGE_PHYTIUM_OPTEE_CUSTOM_REPO_URL
	string "URL of phytium optee custom repository"
	help
	  Specific location of the reference source tree Git
	  repository.

config BR2_PACKAGE_PHYTIUM_OPTEE_CUSTOM_REPO_VERSION
	string "Custom repository version"
	help
	  Revision to use in the typical format used by Git, i.e a
	  SHA1 or a tag.

config BR2_PACKAGE_PHYTIUM_OPTEE_BOARD
	string "Target board"
	help
	  Value for the target board directive provided to
	  Phytium OPTEE build script. Support:
	  "e2000demod", debug version;
	  "e2000demor", release version.

endif # BR2_PACKAGE_PHYTIUM_OPTEE
```

## package/vpu-lib/Config.in
```kconfig
config BR2_PACKAGE_VPU_LIB
	bool "vpu-lib"
	help
	  This is a comment that explains what vpu-lib is. The help text
	  should be wrapped.

          https://gitee.com/phytium_embedded/vpu-lib.git

if BR2_PACKAGE_VPU_LIB

config BR2_PACKAGE_VPU_LIB_CPU_MODEL
        string "cpu model"
        help
          This is a comment that defines cpu model is, d2000 or e2000

config BR2_PACKAGE_VPU_LIB_FIRMWARE
        bool "vpu-lib firmware"
        help
          Install only vpu-lib firmware and do not install other files.

endif
```

## package/xorg-rogue-umlibs/Config.in
```kconfig
config BR2_PACKAGE_XORG_ROGUE_UMLIBS
	bool "xorg-rogue-umlibs"
	help
	  This is a comment that explains what xorg-rogue-umlibs is. The help text
	  should be wrapped.

	  https://gitee.com/phytium_embedded/phytium-rogue-umlibs.git

if BR2_PACKAGE_XORG_ROGUE_UMLIBS

config BR2_PACKAGE_XORG_ROGUE_UMLIBS_FIRMWARE
	bool "xorg-rogue-umlibs firmware"
	help
	  Install only xorg-rogue-umlibs firmware and do not install other files.

endif
```
